/dts-v1/;
/plugin/;

#include "waipio-audio-qrd.dtsi"
 / {
	model = "Qualcomm Technologies, Inc. Waipio QRD";
	compatible = "qipio-qrd", "com,waipio", "qcom,qrd";
	qcom,msm-id = <457 0x10000>, <482 0x10000>;
	qcom,board-id = <0x1000B 0>;
};
