#include <dt-bindings/clock/qcom,camcc-waipio.h>
#include <dt-bindings/clock/qcom,videocc-waipio.h>
#include <dt-bindings/clock/qcom,dispcc-waipio.h>

&soc {
	msm_mmrm: qcom,mmrm {
		compatible = "qcom,msm-mmrm", "qcom,waipio-mmrm";
		status = "ok";

		/* MM Rail info */
		mm-rail-corners = "svsl1", "nom", "turbo";
		mm-rail-fact-volt = <44827 49283 54526>;

		/* Scaling factors */
		scaling-fact-dyn = <54133 66345 82613>;
		scaling-fact-leak = <499319 589741 716198>;

		/* Client info */
		mmrm-client-info =
			<0x1 CAM_CC_IFE_0_CLK_SRC 36280730 260834>,
			<0x1 CAM_CC_IFE_1_CLK_SRC 36280730 260834>,
			<0x1 CAM_CC_IFE_2_CLK_SRC 36280730 260834>,
			<0x1 CAM_CC_CSID_CLK_SRC 2160722 0>,
			<0x1 CAM_CC_SFE_0_CLK_SRC 20833895 135660>,
			<0x1 CAM_CC_SFE_1_CLK_SRC 20833895 135660>,
			<0x1 CAM_CC_IPE_NPS_CLK_SRC 67423437 608830>,
			<0x1 CAM_CC_BPS_CLK_SRC 19833816 212992>,
			<0x1 CAM_CC_IFE_LITE_CLK_SRC 1698431 20055>,
			<0x1 CAM_CC_JPEG_CLK_SRC 1011876 0>,
			<0x1 CAM_CC_CAMNOC_AXI_CLK_SRC 3407872 589824>,
			<0x1 CAM_CC_IFE_LITE_CSID_CLK_SRC 262144 0>,
			<0x1 CAM_CC_ICP_CLK_SRC 314573 0>,
			<0x1 CAM_CC_CPHY_RX_CLK_SRC 222823 0>,
			<0x1 CAM_CC_CSI0PHYTIMER_CLK_SRC 6554 0>,
			<0x1 CAM_CC_CSI1PHYTIMER_CLK_SRC 6554 0>,
			<0x1 CAM_CC_CSI2PHYTIMER_CLK_SRC 6554 0>,
			<0x1 CAM_CC_CSI3PHYTIMER_CLK_SRC 6554 0>,
			<0x1 CAM_CC_CSI4PHYTIMER_CLK_SRC 6554 0>,
			<0x1 CAM_CC_CSI5PHYTIMER_CLK_SRC 6554 0>,
			<0x1 CAM_CC_CCI_0_CLK_SRC 656 0>,
			<0x1 CAM_CC_CCI_1_CLK_SRC 656 0>,
			<0x1 CAM_CC_SLOW_AHB_CLK_SRC 70124 0>,
			<0x1 CAM_CC_FAST_AHB_CLK_SRC 35390 0>,
			<0x2 VIDEO_CC_MVS1_CLK_SRC 81149297 488244>,
			<0x3 DISP_CC_MDSS_MDP_CLK_SRC 21954560 184812>,
			<0x4 VIDEO_CC_MVS0_CLK_SRC 28970189 582288>;
	};
};
