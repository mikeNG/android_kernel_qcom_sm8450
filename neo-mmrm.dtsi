&soc {
	msm_mmrm: qcom,mmrm {
		compatible = "qcom,msm-mmrm", "qcom,neo-mmrm";
		status = "okay";

		/* MM Rail info */
		mm-rail-corners = "lowsvs", "svs", "svsl1", "nom", "turbo";
		mm-rail-fact-volt = <37487 41157 44827 47711 52429>;

		/* Scaling factors */
		scaling-fact-dyn = <39951 48654 58347 66677 81757>;
		scaling-fact-leak = <39951 671797 784172 884468 1082937>;

		/* Client info */
		mmrm-client-info =
			<0x1 CAM_CC_IFE_0_CLK_SRC 28892522 203064 1>,
			<0x1 CAM_CC_IFE_1_CLK_SRC 28892522 203064 1>,
			<0x1 CAM_CC_CSID_CLK_SRC 1858221 0 2>,
			<0x1 CAM_CC_IPE_NPS_CLK_SRC 57984156 499975 1>,
			<0x1 CAM_CC_BPS_CLK_SRC 17057081 124257 1>,
			<0x1 CAM_CC_BPS_CLK_SRC 43645928 0 1>,
			<0x1 CAM_CC_IFE_LITE_CLK_SRC 1556480 16417 8>,
			<0x1 CAM_CC_JPEG_CLK_SRC 521667 0 3>,
			<0x1 CAM_CC_CAMNOC_AXI_CLK_SRC 2930770 240452 1>,
			<0x1 CAM_CC_IFE_LITE_CSID_CLK_SRC 225444 0 8>,
			<0x1 CAM_CC_ICP_CLK_SRC 270533 0 1>,
			<0x1 CAM_CC_CPHY_RX_CLK_SRC 191628 0 9>,
			<0x1 CAM_CC_CSI0PHYTIMER_CLK_SRC 5637 0 1>,
			<0x1 CAM_CC_CSI1PHYTIMER_CLK_SRC 5637 0 1>,
			<0x1 CAM_CC_CSI2PHYTIMER_CLK_SRC 5637 0 1>,
			<0x1 CAM_CC_CSI3PHYTIMER_CLK_SRC 5637 0 1>,
			<0x1 CAM_CC_CCI_0_CLK_SRC 564 0 1>,
			<0x1 CAM_CC_CCI_1_CLK_SRC 564 0 1>,
			<0x1 CAM_CC_SLOW_AHB_CLK_SRC 60307 0 1>,
			<0x1 CAM_CC_FAST_AHB_CLK_SRC 30435 0 1>,

			<0x2 VIDEO_CC_MVS1_CLK_SRC 102105088 734004 1>,
			<0x3 DISP_CC_MDSS_MDP_CLK_SRC 18345493 251659 1>,
			<0x3 DISP_CC_MDSS_DPTX0_LINK_CLK_SRC 912917 5243 1>,
			<0x4 VIDEO_CC_MVS0_CLK_SRC 36275487 425984 1>;
	};
};
