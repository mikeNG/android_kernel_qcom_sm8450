/dts-v1/;
/plugin/;

#include "ravelin-audio-idp.dtsi"

/ {
	model = "Qualcomm Technologies, Inc. Ravelin IDP";
	compatible = "qcom,ravelin-idp", "qcom,ravelin", "qcom,idp";
	qcom,msm-id = <568 0x10000>;
	qcom,board-id = <34 0>, <34 0x600>;
};
