/dts-v1/;
/plugin/;

#include <dt-bindings/clock/qcom,gcc-cape.h>
#include <dt-bindings/clock/qcom,camcc-cape.h>
#include <dt-bindings/interconnect/qcom,cape.h>
#include <dt-bindings/interrupt-controller/arm-gic.h>
#include <dt-bindings/regulator/qcom,rpmh-regulator-levels.h>

#include "cape-camera-sensor-cdp.dtsi"
/ {
	model = "Qualcomm Technologies, Inc. Cape CDP";
	compatible = "qcom,cape";
	qcom,msm-id = <530 0x10000>;
	qcom,board-id = <1 0>;
};
